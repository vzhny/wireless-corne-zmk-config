## config/Kconfig
```kconfig
config NICE_VIEW_WIDGET_INVERTED
	bool "Invert nice!view widget colors (black background, white ink)"
	default n
	depends on ZMK_DISPLAY
```

## config/west.yml
```yaml
manifest:
  remotes:
    - name: zmkfirmware
      url-base: https://github.com/zmkfirmware
  projects:
    - name: zmk
      remote: zmkfirmware
      revision: f84ef436cd8e88f9d1580a9b86bab2fae8d349c6
      import: app/west.yml
  self:
    path: config
```
